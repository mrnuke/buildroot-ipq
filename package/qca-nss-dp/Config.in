## package/qca-nss-dp/Config.in
```kconfig
comment "NSS-DP needs a Linux kernel to be built"
	depends on !BR2_LINUX_KERNEL

config BR2_PACKAGE_QCA_NSS_DP
	bool "Qualcomm NSS-DP"
	depends on BR2_LINUX_KERNEL
	depends on BR2_PACKAGE_QCA_SSDK
	depends on BR2_PACKAGE_QCA_NSS_PPE
	help
	  This package provides Qualcomm NSS dataplane ethernet driver for Qualcom SoCs.
```

## package/qca-nss-ppe/Config.in
```kconfig
comment "NSS-PPE needs a Linux kernel to be built"
	depends on !BR2_LINUX_KERNEL

config BR2_PACKAGE_QCA_NSS_PPE
	bool "Qualcomm NSS-PPE"
	depends on BR2_LINUX_KERNEL
	depends on BR2_PACKAGE_QCA_SSDK
	help
	  This package provides Qualcomm NSS package processor engine driver for Qualcom SoCs.
```
