## package/ath11k-firmware-tplink/Config.in
```kconfig
config BR2_PACKAGE_ATH11K_FIRMWARE_TPLINK
	bool "ath11k firmware for tplink"
	help
	  This package contains to firmware required for wifi-7 tplink devices
	  with old-school wifi-6 radios on 2.4GHz bands.

if BR2_PACKAGE_ATH11K_FIRMWARE_TPLINK

config BR2_PACKAGE_ATH11K_FIRMWARE_TPLINK_IPQ9574
	bool "IPQ9574 remoteproc firmware"
	help
	  TP-Link firmware files for IPQ9574 AHB series.

config BR2_PACKAGE_ATH11K_BDF_TPLINK_BE550
        bool "Board file for TP-Link BE550, 2.4 GHz"
        help
          BDF file for the 2.4 GHz wifi chip on TP-Link BE550.

endif
```

## package/ath11k-firmware/Config.in
```kconfig
config BR2_PACKAGE_ATH11K_FIRMWARE
	bool "ath11k-firmware"
	help
	  This package enables access to firmware required for
	  ath11k supported devices to operate.

if BR2_PACKAGE_ATH11K_FIRMWARE

config BR2_PACKAGE_ATH11K_FIRMWARE_IPQ8074
	bool "IPQ8074 firmware"
	help
	  Firmware files for IPQ807x SoC series.

config BR2_PACKAGE_ATH11K_FIRMWARE_IPQ9574
	bool "IPQ9574 firmware"
	help
	  Firmware files for IPQ95xx SoC series.

config BR2_PACKAGE_ATH11K_FIRMWARE_QCN9074
	bool "QCN9074 firmware"
	help
	  Firmware files for QCN9074 PCI series.

config BR2_PACKAGE_ATH12K_FIRMWARE_QCN9274
	bool "QCN9274 firmware"
	help
	  Firmware files for QCN9274 PCI series.

endif
```

## package/ath12k-firmware-tplink/Config.in
```kconfig
config BR2_PACKAGE_ATH12K_FIRMWARE_TPLINK
	bool "ath12k firmware for tplink"
	help
	  This package contains to firmware required for ath12k tplink devices
	  to operate.

if BR2_PACKAGE_ATH12K_FIRMWARE_TPLINK

config BR2_PACKAGE_ATH12K_FIRMWARE_TPLINK_QCN9224
	bool "QCN9224 firmware"
	help
	  TP-Link firmware files for QCN9224 PCI series.

config BR2_PACKAGE_ATH12K_BDF_TPLINK_BE550
	bool "Board file for TP-Link BE550"
	help
	  BDF files TP-Link BE550 wifi.

endif
```
